## drivers/soc/oppo/oppo_dump/Kconfig
```kconfig
config OPPO_FORCE_DUMP
	bool "Oppo force dump support"
	help
	  Enable this option to define force dump functions
	  used for debugging and stability checks.
```
